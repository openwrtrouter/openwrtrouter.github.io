## _p2w_r619ac-128m/target-arm_cortex-a7+neon-vfpv4_musl_eabi/linux-ipq40xx/p2w_r619ac-128m-fit-zImage.itb.its
```
/dts-v1/;

/ {
	description = "ARM OpenWrt FIT (Flattened Image Tree)";
	#address-cells = <1>;

	images {
		kernel-1 {
			description = "ARM OpenWrt Linux-5.4.158";
			data = /incbin/("/workdir/openwrt/build_dir/target-arm_cortex-a7+neon-vfpv4_musl_eabi/linux-ipq40xx/p2w_r619ac-128m-fit-zImage.itb");
			type = "kernel";
			arch = "arm";
			os = "linux";
			compression = "none";
			load = <0x80208000>;
			entry = <0x80208000>;
			hash@1 {
				algo = "crc32";
			};
			hash@2 {
				algo = "sha1";
			};
		};


		fdt-1 {
			description = "ARM OpenWrt p2w_r619ac-128m device tree blob";
			
			data = /incbin/("/workdir/openwrt/build_dir/target-arm_cortex-a7+neon-vfpv4_musl_eabi/linux-ipq40xx/linux-5.4.158/arch/arm/boot/dts/qcom-ipq4019-r619ac-128m.dtb");
			type = "flat_dt";
			
			arch = "arm";
			compression = "none";
			hash@1 {
				algo = "crc32";
			};
			hash@2 {
				algo = "sha1";
			};
		};



	};

	configurations {
		default = "config@10";
		config@10 {
			description = "OpenWrt p2w_r619ac-128m";
			kernel = "kernel-1";
			fdt = "fdt-1";
			
			
			
		};
		
	};
};
```
